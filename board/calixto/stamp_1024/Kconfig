## board/calixto/stamp_1024/Kconfig
```kconfig
# SPDX-License-Identifier: GPL-2.0+
#
# Copyright (C) 2025 Texas Instruments Incorporated - https://www.ti.com/
#

if TARGET_AM62L3_STAMP_1024

config SYS_BOARD
       default "stamp_1024"

config SYS_VENDOR
       default "calixto"

config SYS_CONFIG_NAME
       default "stamp_1024"

source "board/calixto/common/Kconfig"

endif
```

## board/calixto/stamp_2048/Kconfig
```kconfig
# SPDX-License-Identifier: GPL-2.0+
#
# Copyright (C) 2025 Texas Instruments Incorporated - https://www.ti.com/
#

if TARGET_AM62L3_STAMP

config SYS_BOARD
       default "stamp_2048"

config SYS_VENDOR
       default "calixto"

config SYS_CONFIG_NAME
       default "stamp_2048"

source "board/calixto/common/Kconfig"

endif
```
